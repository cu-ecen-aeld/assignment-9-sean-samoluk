## base_external/package/aesdchar/Config.in
```kconfig
config BR2_PACKAGE_AESDCHAR
	bool "aesdchar"
	help
	  Includes the scull and misc-modules modules in the kernel image.
	  Used to understand buildroot external trees and package builds.
```
